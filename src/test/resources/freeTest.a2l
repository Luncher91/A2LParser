/* This file has been handwritten */ ASAP2_VERSION 1 71 A2ML_VERSION 1 31
/begin PROJECT Free_Example "MIT licensed example file"
/begin HEADER "Free Asap2 example file" VERSION "V1.7.1" PROJECT_NO Free42 /end HEADER
/begin MODULE sample_module "great example with different escaped quotation \" marks like double quotes "" and backslash escaped at the end \""
/begin BLOB i am not parsed neither /end BLOB
/begin USER_RIGHTS admins READ_ONLY /begin REF_GROUP g1 g2 g3 /end REF_GROUP /end USER_RIGHTS
/begin VARIANT_CODING VAR_SEPARATOR "#" VAR_NAMING NUMERIC
 /begin VAR_CHARACTERISTIC varChar crit1 crit2 crit3 /begin VAR_ADDRESS 0x7444 0x7445 0x7446 0x7447 /end VAR_ADDRESS /end VAR_CHARACTERISTIC
 /begin VAR_CRITERION varCriterion "var criterion" A B C D E F VAR_MEASUREMENT superA VAR_SELECTION_CHARACTERISTIC varSelectionCharac /end VAR_CRITERION
 /begin VAR_FORBIDDEN_COMB varCriterion D varCriterion F /end VAR_FORBIDDEN_COMB
/end VARIANT_CODING
/begin AXIS_PTS axis_pts_1 "I am a long identifier of an AXIS_PTS object" 0xABCDEF NO_INPUT_QUANTITY axis_pts_deposit 1.1 THE.IDENTITY 123 1.2 1.3 CALIBRATION_ACCESS NOT_IN_MCD_SYSTEM DEPOSIT DIFFERENCE DISPLAY_IDENTIFIER display.identifier.wohoo ECU_ADDRESS_EXTENSION 0x9783 EXTENDED_LIMITS 0.1 0.5 FORMAT "%1212.21" MONOTONY NOT_MON PHYS_UNIT "m/(s*s)" REF_MEMORY_SEGMENT memorySegment.42 STEP_SIZE 820.028 SYMBOL_LINK "symbol name char 99" 99 /end AXIS_PTS
/begin CHARACTERISTIC char_a "any unknown es\cape\d\ \character, escaped backslash \\ and for fun \\\ and \\\\" CUBE_5 0x123 char_deposit 1.1 char_conv 0.0 10.0
 /begin AXIS_DESCR CURVE_AXIS superMeasurement char_conv 22 5.5 21.21 AXIS_PTS_REF axis_pts_1 CURVE_AXIS_REF char_b DEPOSIT DIFFERENCE FORMAT "%3.3" MAX_GRAD 30.0 MONOTONY NOT_MON PHYS_UNIT "m/(s*s)" READ_ONLY STEP_SIZE 1.2 FIX_AXIS_PAR 2 4 8 FIX_AXIS_PAR_DIST 4 16 32 /begin FIX_AXIS_PAR_LIST 1.1 2.2 3.3 4.4 5.5 /end FIX_AXIS_PAR_LIST /end AXIS_DESCR
 BIT_MASK 0xFFFFFFFFFFFFFFFF BYTE_ORDER MSB_LAST CALIBRATION_ACCESS CALIBRATION COMPARISON_QUANTITY comparisonQuantity /begin DEPENDENT_CHARACTERISTIC "X1*X2" characA characB /end DEPENDENT_CHARACTERISTIC DISCRETE DISPLAY_IDENTIFIER display_ident_char ECU_ADDRESS_EXTENSION 10000 EXTENDED_LIMITS 1.1 5.5 FORMAT "%12.12" /begin MAP_LIST identA identB /end MAP_LIST NUMBER 1233123 PHYS_UNIT "kg" READ_ONLY /begin VIRTUAL_CHARACTERISTIC "sin(cos(X2-X1))" characteristicA characteristicB /end VIRTUAL_CHARACTERISTIC REF_MEMORY_SEGMENT memory_seg_ref STEP_SIZE 99.9 SYMBOL_LINK "symbol name char" 7 MAX_REFRESH 6 10 MATRIX_DIM 3 /begin FUNCTION_LIST f1 f2 f3 /end FUNCTION_LIST
 /begin ANNOTATION /begin ANNOTATION_TEXT "hello world" /end ANNOTATION_TEXT /end ANNOTATION
/end CHARACTERISTIC
/begin CHARACTERISTIC char_b "test line break in string\
<<here" CUBE_5 0x123 char_deposit 1.1 char_conv .1 1. /end CHARACTERISTIC
/begin CHARACTERISTIC char_c "description here" CUBE_5 0x123 char_deposit 1.1 char_conv .1E-2 1.E2 /end CHARACTERISTIC
/begin CHARACTERISTIC veRy_ComPlex[identifier_123].and.I.am.lo__n_g "" CUBE_5 0x123 char_deposit 1.1 char_conv .1 1. /end CHARACTERISTIC
/begin MOD_COMMON "" DEPOSIT DIFFERENCE BYTE_ORDER MSB_FIRST ALIGNMENT_BYTE 2 ALIGNMENT_WORD 1 ALIGNMENT_LONG 3 ALIGNMENT_FLOAT32_IEEE 8 ALIGNMENT_FLOAT64_IEEE 8 DATA_SIZE 128 /end MOD_COMMON
/begin MOD_PAR "cmt" ADDR_EPK 0x12 ADDR_EPK 0x123456 ADDR_EPK 0xF CPU_TYPE "RISC" CUSTOMER "public domain" CUSTOMER_NO "42" ECU "RISC-V" ECU_CALIBRATION_OFFSET 0x54 EPK "EPROM_identification - should it be a string or an identifier?" NO_OF_INTERFACES 168 PHONE_NO "911" SUPPLIER "Andreas Lenzen" USER "A2l stakeholders" VERSION "Very high :-)"
 /begin MEMORY_SEGMENT mem1 "lots of code in internal flash" CODE FLASH INTERN 0x42 4096 -1 -1 -1 -1 -1 /end MEMORY_SEGMENT
 /begin MEMORY_LAYOUT PRG_CODE 0x0010 4096 5 4 3 2 1 /end MEMORY_LAYOUT
 /begin CALIBRATION_METHOD "methodA" 3141
  /begin CALIBRATION_HANDLE 0x10000 0x300 0x7 0x700000 0x40000 CALIBRATION_HANDLE_TEXT "important!" /end CALIBRATION_HANDLE
  /begin CALIBRATION_HANDLE 0x0 0x10 /end CALIBRATION_HANDLE
 /end CALIBRATION_METHOD
 SYSTEM_CONSTANT "close to 1" "value 1"
 SYSTEM_CONSTANT "pi" "about 3" /end MOD_PAR
/begin COMPU_METHOD THE.IDENTITY "very unique" RAT_FUNC "%8.4" "°" COEFFS 0 1.1 0 0 0 1.1 COEFFS_LINEAR 7.1 -12.5 COMPU_TAB_REF PERFECT_COMPU.TAB /end COMPU_METHOD
/begin COMPU_METHOD THE.FORMULA "very unique" FORM "%8.4" "°" /begin FORMULA "X1-42" FORMULA_INV "X1+42" /end FORMULA /end COMPU_METHOD
/begin COMPU_METHOD char_conv "Conversion method for char" RAT_FUNC "%3.0" "NO_PHYSICAL_QTY" COEFFS 0 1 0 0 0 1 /end COMPU_METHOD
/begin COMPU_TAB PERFECT_COMPU.TAB "very perfect compu tab" TAB_INTP 5 -1.1 -1.1 1 -1 1.123456 0.312312 3123 3123 0 0.0 DEFAULT_VALUE "invalid input value" /end COMPU_TAB
/begin COMPU_VTAB firstVtab "very first vtab" TAB_VERB 3 1.1 "first entry" 0.9 "second entry" 0 "third entry" DEFAULT_VALUE "default value" /end COMPU_VTAB
/begin COMPU_VTAB_RANGE sophisticated.vtabRange "I am very sophisticated, trust me" 4 -5.5 5.5 "from minus five point five to five point five" 5.5 10 "from five point five to ten" 10 100 "from ten to one hundred" 100 200 "from one hundred to two hundred" DEFAULT_VALUE "default" /end COMPU_VTAB_RANGE
/begin MEASUREMENT superMeasurement "ultimate test" UBYTE THE.IDENTITY 1 2.1 4.2 255 ARRAY_SIZE 7 DISCRETE PHYS_UNIT "kg/m" BIT_MASK 0xAFFF REF_MEMORY_SEGMENT mem1 ECU_ADDRESS 0xABCDEF ECU_ADDRESS_EXTENSION 0xFF ERROR_MASK 0x000E FORMAT "%3.1" DISPLAY_IDENTIFIER mega.superMeasurement
 /begin ANNOTATION ANNOTATION_LABEL "annotation I" ANNOTATION_ORIGIN "me" /begin ANNOTATION_TEXT "row \\'1\'\\" "row '2'\r\n" "row\t3" /end ANNOTATION_TEXT /end ANNOTATION
 /begin BIT_OPERATION RIGHT_SHIFT 4 SIGN_EXTEND /end BIT_OPERATION
 /begin FUNCTION_LIST firstFunction secondFunction thirdFunction /end FUNCTION_LIST
 LAYOUT ROW_DIR MATRIX_DIM 7 8 10 MAX_REFRESH 12 42 READ_WRITE SYMBOL_LINK "symbol name" 84 /begin VIRTUAL meas_1 meas_2 /end VIRTUAL /end MEASUREMENT
/begin RECORD_LAYOUT master_record ALIGNMENT_BYTE 2 ALIGNMENT_FLOAT32_IEEE 4 ALIGNMENT_FLOAT64_IEEE 8 ALIGNMENT_INT64 16 ALIGNMENT_LONG 32 ALIGNMENT_WORD 64 AXIS_PTS_X 1 SBYTE INDEX_INCR DIRECT AXIS_PTS_Y 2 UBYTE INDEX_DECR PBYTE AXIS_PTS_Z 3 UBYTE INDEX_DECR PBYTE AXIS_PTS_4 4 UBYTE INDEX_DECR PBYTE AXIS_PTS_5 5 UBYTE INDEX_DECR PBYTE AXIS_RESCALE_X 6 UBYTE 3141 INDEX_DECR PBYTE AXIS_RESCALE_Y 7 UBYTE 3141 INDEX_DECR PBYTE AXIS_RESCALE_Z 8 UBYTE 3141 INDEX_DECR PBYTE AXIS_RESCALE_4 9 UBYTE 3141 INDEX_DECR PBYTE AXIS_RESCALE_5 10 UBYTE 3141 INDEX_DECR PBYTE DIST_OP_X 11 SBYTE DIST_OP_Y 12 SBYTE DIST_OP_Z 13 SBYTE DIST_OP_4 14 SBYTE DIST_OP_5 15 SBYTE FIX_NO_AXIS_PTS_X 1 FIX_NO_AXIS_PTS_Y 2 FIX_NO_AXIS_PTS_Z 3 FIX_NO_AXIS_PTS_4 4 FIX_NO_AXIS_PTS_5 5 FNC_VALUES 47 UBYTE ALTERNATE_CURVES PLONG IDENTIFICATION 48 ULONG NO_AXIS_PTS_X 16 UBYTE NO_AXIS_PTS_Y 17 UBYTE NO_AXIS_PTS_Z 18 UBYTE NO_AXIS_PTS_4 19 UBYTE NO_AXIS_PTS_5 20 UBYTE NO_RESCALE_X 21 ULONG NO_RESCALE_Y 22 ULONG NO_RESCALE_Z 23 ULONG NO_RESCALE_4 24 ULONG NO_RESCALE_5 25 ULONG OFFSET_X 26 ULONG OFFSET_Y 27 ULONG OFFSET_Z 28 ULONG OFFSET_4 29 ULONG OFFSET_5 30 ULONG RESERVED 49 LONG RESERVED 50 WORD RIP_ADDR_W 31 ULONG RIP_ADDR_X 32 ULONG RIP_ADDR_Y 33 ULONG RIP_ADDR_Z 34 ULONG RIP_ADDR_4 35 ULONG RIP_ADDR_5 36 ULONG SRC_ADDR_X 37 ULONG SRC_ADDR_Y 38 ULONG SRC_ADDR_Z 39 ULONG SRC_ADDR_4 40 ULONG SRC_ADDR_5 41 ULONG SHIFT_OP_X 42 ULONG SHIFT_OP_Y 43 ULONG SHIFT_OP_Z 44 ULONG SHIFT_OP_4 45 ULONG SHIFT_OP_5 46 ULONG STATIC_RECORD_LAYOUT /end RECORD_LAYOUT
/begin RECORD_LAYOUT char_deposit FNC_VALUES 1 UBYTE ROW_DIR DIRECT /end RECORD_LAYOUT
/begin FUNCTION firstFunction "very first function" /begin DEF_CHARACTERISTIC char1 char2 char3 /end DEF_CHARACTERISTIC FUNCTION_VERSION "version3.1.4.1" /begin IN_MEASUREMENT meas1 meas2 meas3 /end IN_MEASUREMENT /begin LOC_MEASUREMENT locMeas1 locMeas2 locMeas3 /end LOC_MEASUREMENT /begin OUT_MEASUREMENT outMeas1 outMeas2 outMeas3 /end OUT_MEASUREMENT /begin REF_CHARACTERISTIC refChar1 refChar2 refChar3 /end REF_CHARACTERISTIC /begin SUB_FUNCTION subFunc1 subFunc2 subFunc3 /end SUB_FUNCTION /end FUNCTION
/begin UNIT unitA "detailed description with spaces" "display string" DERIVED REF_UNIT unitB SI_EXPONENTS 5 2 7 10 12 14 16 UNIT_CONVERSION 10.1 2.2 /end UNIT
/begin GROUP groupies "stick to the group" ROOT /begin REF_CHARACTERISTIC refChar1 refChar2 refChar3 /end REF_CHARACTERISTIC /begin REF_MEASUREMENT meas1 meas2 meas3 meas[0][0] /end REF_MEASUREMENT /begin SUB_GROUP subGroup1 subGroup2 subGroup3 /end SUB_GROUP /end GROUP
/begin FRAME frame "big frame" 7 49 FRAME_MEASUREMENT identA identB identC /end FRAME
/end MODULE
/end PROJECT
