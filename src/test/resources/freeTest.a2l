/* This file hase been handwritten */ ASAP2_VERSION 1 71 A2ML_VERSION 1 31
/begin PROJECT Free_Example "MIT licensed example file"
/begin HEADER "Free Asap2 example file" VERSION "V1.7.1" PROJECT_NO Free42 /end HEADER
/begin MODULE sample_module "great example with different escaped quotation \" marks like double quotes "" and backslash escaped at the end \""
/begin BLOB i am not parsed neither /end BLOB
/begin AXIS_PTS axis_pts_1 "I am a long identifier of an AXIS_PTS object" 0xABCDEF in_quant axis_pts_deposit 1.1 axis_pts_conv 123 1.2 1.3 CALIBRATION_ACCESS NOT_IN_MCD_SYSTEM DEPOSIT DIFFERENCE DISPLAY_IDENTIFIER display.identifier.wohoo ECU_ADDRESS_EXTENSION 0x9783 EXTENDED_LIMITS 0.1 0.5 FORMAT "%1212.21" MONOTONY NOT_MON PHYS_UNIT "m/(s*s)" REF_MEMORY_SEGMENT memorySegment.42 STEP_SIZE 820.028 /end AXIS_PTS
/begin CHARACTERISTIC char_a "description here" CUBE_5 0x123 char_deposit 1.1 char_conv 0.0 10.0
 /begin AXIS_DESCR CURVE_AXIS in_quant_char char_axis_descr_conv 22 5.5 21.21 AXIS_PTS_REF axisPtsA CURVE_AXIS_REF curveAxisA DEPOSIT DIFFERENCE FORMAT "%3.3" MAX_GRAD 30.0 MONOTONY NOT_MON PHYS_UNIT "m/(s*s)" READ_ONLY STEP_SIZE 1.2 /end AXIS_DESCR
 BIT_MASK 0xFFFFFF BYTE_ORDER MSB_LAST CALIBRATION_ACCESS CALIBRATION DISCRETE DISPLAY_IDENTIFIER display_ident_char ECU_ADDRESS_EXTENSION 10000 FORMAT "%12.12" /begin MAP_LIST identA identB /end MAP_LIST NUMBER 1233123 PHYS_UNIT "kg" READ_ONLY /begin VIRTUAL_CHARACTERISTIC "sin(cos(X2-X1))" characteristicA characteristicB /end VIRTUAL_CHARACTERISTIC REF_MEMORY_SEGMENT memory_seg_ref STEP_SIZE 99.9 /end CHARACTERISTIC
/begin MOD_COMMON "" DEPOSIT DIFFERENCE BYTE_ORDER MSB_FIRST ALIGNMENT_BYTE 2 ALIGNMENT_WORD 1 ALIGNMENT_LONG 3 ALIGNMENT_FLOAT32_IEEE 8 ALIGNMENT_FLOAT64_IEEE 8 DATA_SIZE 128 /end MOD_COMMON
/begin MOD_PAR "cmt" ADDR_EPK 0x12 ADDR_EPK 0x123456 ADDR_EPK 0xF CPU_TYPE "RISC" CUSTOMER "public domain" CUSTOMER_NO "42" ECU "RISC-V" ECU_CALIBRATION_OFFSET 0x54 EPK "EPROM_identification - should it be a string or an identifier?" NO_OF_INTERFACES 168 PHONE_NO "911" SUPPLIER "Andreas Lenzen" USER "A2l stakeholders" VERSION "Very high :-)"
 /begin MEMORY_SEGMENT mem1 "lots of code in internal flash" CODE FLASH INTERN 0x42 4096 -1 -1 -1 -1 -1 /end MEMORY_SEGMENT
/end MOD_PAR
/begin COMPU_METHOD THE.IDENTITY "very unique" RAT_FUNC "%8.4" "°" COEFFS 0 1.1 0 0 0 1.1 /end COMPU_METHOD
/begin COMPU_METHOD THE.FORMULA "very unique" FORM "%8.4" "°" /begin FORMULA "X1-42" FORMULA_INV "X1+42" /end FORMULA /end COMPU_METHOD
/begin COMPU_TAB PERFECT_COMPU.TAB "very perfect compu tab" TAB_INTP 5 -1.1 -1.1 1 -1 1.123456 0.312312 3123 3123 0 0.0 DEFAULT_VALUE "invalid input value" /end COMPU_TAB
/begin COMPU_VTAB firstVtab "very first vtab" TAB_VERB 3 1.1 "first entry" 0.9 "second entry" 0 "third entry" DEFAULT_VALUE "default value" /end COMPU_VTAB
/begin COMPU_VTAB_RANGE sophisticated.vtabRange "I am very sophisticated, trust me" 4 -5.5 5.5 "from minus five point five to five point five" 5.5 10 "from five point five to ten" 10 100 "from ten to one hundred" 100 200 "from one hundred to two hundred" DEFAULT_VALUE "default" /end COMPU_VTAB_RANGE
/begin MEASUREMENT superMeasurement "ultimate test" UBYTE THE.IDENTITY 1 2.1 4.2 255 PHYS_UNIT "kg/m" BIT_MASK 0xAFFF REF_MEMORY_SEGMENT mem1 ECU_ADDRESS 0xABCDEF FORMAT "%3.1" DISPLAY_IDENTIFIER mega.superMeasurement
 /begin ANNOTATION ANNOTATION_LABEL "annotation I" ANNOTATION_ORIGIN "me" /begin ANNOTATION_TEXT "row \\'1\'\\" "row '2'\r\n" "row\t3" /end ANNOTATION_TEXT /end ANNOTATION
 /begin BIT_OPERATION RIGHT_SHIFT 4 SIGN_EXTEND /end BIT_OPERATION
 /begin FUNCTION_LIST firstFunction secondFunction thirdFunction /end FUNCTION_LIST
 MATRIX_DIM 7 8 10 MAX_REFRESH 12 42 SYMBOL_LINK "symbol name" 84 /begin VIRTUAL meas_1 meas_2 /end VIRTUAL /end MEASUREMENT
/begin UNIT unitA "detailed description with spaces" "display string" DERIVED REF_UNIT unitB SI_EXPONENTS 5 2 7 10 12 14 16 UNIT_CONVERSION 10.1 2.2 /end UNIT
/end MODULE
/end PROJECT
